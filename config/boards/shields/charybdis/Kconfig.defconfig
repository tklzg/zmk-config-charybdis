## config/boards/shields/charybdis/Kconfig.defconfig
```kconfig
# Copyright (c) 2020 Ryan Cross
# SPDX-License-Identifier: MIT

if SHIELD_CHARYBDIS_DONGLE

config ZMK_KEYBOARD_NAME
    default "Charybdis"

config ZMK_SPLIT_ROLE_CENTRAL
    default y

config ZMK_USB
    default y

endif

if SHIELD_CHARYBDIS_LEFT || SHIELD_CHARYBDIS_RIGHT || SHIELD_CHARYBDIS_DONGLE

config ZMK_SPLIT
    default y

config ZMK_BLE
    default y

endif

config MOUSE_LAYER_INDEX
	int "Index of mouse layer"
	default 4

config SCROLL_LAYER_INDEX
	int "Index of scroll layer"
	default 5

config MOUSE_LAYER_ACTIVE_MS
	int "Amount of milliseconds the mouse layer will be active after using the trackball"
	default 400
```

## config/boards/shields/charybdis/Kconfig.shield
```kconfig
# Copyright (c) 2020 Ryan Cross
# SPDX-License-Identifier: MIT

config SHIELD_CHARYBDIS_LEFT
    def_bool $(shields_list_contains,charybdis_left)

config SHIELD_SOFLE_RIGHT
    def_bool $(shields_list_contains,sofle_right)

config SHIELD_CHARYBDIS_DONGLE
    def_bool $(shields_list_contains,charybdis_dongle)
```

## config/west.yml
```yaml
manifest:
  remotes:
    - name: badjeff
      url-base: https://github.com/badjeff
    - name: tklzg
      url-base: https://github.com/tklzg
  projects:
    - name: zmk-petejohanson
      remote: tklzg
      revision: feat/pointers-move-scroll
    - name: zmk-pmw3610-driver-badjeff
      remote: tklzg
      revision: main
    - name: zmk-split-peripheral-input-relay
      remote: badjeff
      revision: main
    - name: zmk-input-behavior-listener
      remote: tklzg
      revision: main
  self:
    path: config
```
